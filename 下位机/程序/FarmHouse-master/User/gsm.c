/**********************************************************************************
发送中文短信
使用串口3 
**********************************************************************************/

#include "usart.h"
#include "timer.h"
#include "string.h"
#include "gsm.h"
#include "led.h"
#include "delay.h"

static char *text_cn="30106E2999A863D09192301160A87684828270B96570636E5B5857285F025E38FF0C5F025E38539F56E0FF1A";

//发送短信内容:【温馨提醒】您的节点数据存在异常：
/*
   //短信中心号（倒序）      目标手机（倒序）         短信内容（测试已经完成）
     8613800756500F          8613798985989F          
0891 683108706505F0 11000D91 683197985889F9 0008AA0C 6D4B8BD55DF27ECF5B8C6210

// 广西联通短信中心：8613010591500  6831105019050F 目标手机：19943085898： 689149035898F8
// 广西桂林移动：8613800773500
*/

extern u8 First_Int;
extern char Uart3_Buf[Uart3_Buf_Max]; //串口3接收缓存

u8 Times=0,shijian=0;
vu8 Timer0_start;	//定时器0延时启动计数器


/*******************************************************************************
* 函数名 : CLR_Buf2
* 描述   : 清除串口2缓存数据
* 输入   : 
* 输出   : 
* 返回   : 
* 注意   : 
*******************************************************************************/
void CLR_Buf2(void)
{
	u16 k;
	for(k=0;k<Uart3_Buf_Max;k++)      //将缓存内容清零
	{
		Uart3_Buf[k] = 0x00;
	}
    First_Int = 0;              //接收字符串的起始存储位置
}

/*******************************************************************************
* 函数名 : Find
* 描述   : 判断缓存中是否含有指定的字符串
* 输入   : 
* 输出   : 
* 返回   : unsigned char:1 找到指定字符，0 未找到指定字符 
* 注意   : 
*******************************************************************************/

u8 Find(char *a)
{ 
  if(strstr(Uart3_Buf,a)!=NULL)
	    return 1;
	else
			return 0;
}

/*******************************************************************************
* 函数名 : Second_AT_Command
* 描述   : 发送AT指令函数
* 输入   : 发送数据的指针、希望接收到的应答、发送等待时间(单位：S)
* 输出   : 
* 返回   : 
* 注意   : 
*******************************************************************************/

void Send_AT_Command(char *b,char *a,u8 wait_time)         
{
	u8 i;
	char *c;
	c = b;										//保存字符串地址到c
	CLR_Buf2(); 
  i = 0;
	while(i == 0)                    
	{
		if(!Find(a)) 
		{
			if(Timer0_start == 0)
			{
				b = c;							//将字符串地址给b
				for (; *b!='\0';b++)
				{
					while(USART_GetFlagStatus(USART3, USART_FLAG_TC)==RESET);
					USART_SendData(USART3,*b);
				}
				UART3_SendLR();	
				Times = 0;
				shijian = wait_time;
				Timer0_start = 1;
		   }
    }
 	  else
		{
			i = 1;
			Timer0_start = 0;
		}
	}
	CLR_Buf2(); 
}

/*******************************************************************************
* 函数名 : Set_Pdu_Mode
* 描述   : 设置短信为PDU文本模式
* 输入   : 
* 输出   : 
* 返回   : 
* 注意   : 
*******************************************************************************/
void GSM_Set_Pdu_Mode(void)
{
	Send_AT_Command("AT","OK",3);										  
	Send_AT_Command("AT&F","OK",3);										 
	Send_AT_Command("AT+CMGF=1","OK",3);						//设置text模式										  
	Send_AT_Command("AT+CSMP=17,167,2,25","OK",3);	//设置文本模式参数							
	Send_AT_Command("AT+CSCS=\"UCS2\"","OK",3);     //设置为 UCS2 编码字符集
}
/*******************************************************************************
* 函数名 : Send_Pdu_Sms
* 描述   : 发送PDU文本短信
* 输入   : 
* 输出   : 
* 返回   : 
* 注意   : 
*******************************************************************************/
void GSM_Send_Pdu_Sms(char *tel,char *txt)
{
//	LED0=0;
	Send_AT_Command(tel,">",3); //发送数据长度：27（具体的计算方法看串口调试比较）接收到“>”才发送短信内容	
	UART3_SendString(text_cn);     //发送中文短信内容
	UART3_SendString(txt);     //发送英文短信内容
	USART_SendData(USART3 ,0X1A);  //发送结束符
  UART3_SendLR();
//	LED0=1;
}


/*******************************************************************************
* 函数名 : Wait_CREG
* 描述   : 等待模块注册成功
* 输入   : 
* 输出   : 
* 返回   : 
* 注意   : 
*******************************************************************************/
void GSM_Wait_CREG(void)
{
	u8 i;
	u8 k;
	i = 0;
	CLR_Buf2();
  while(i == 0)        			
	{
		CLR_Buf2();        
		UART3_SendString("AT+CREG?");   //查找模块是否注册成功
		UART3_SendLR();
		DelayS(4);  						
		for(k=0;k<Uart3_Buf_Max;k++)      			
		{
		if(Uart3_Buf[k] == ':')
		{
			if((Uart3_Buf[k+4] == '1')||(Uart3_Buf[k+4] == '5'))  //说明模块已经注册成功
			{
				i = 1;
				break;
			}
		}
	}
	}
}
